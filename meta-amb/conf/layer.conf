## meta-amb/conf/layer.conf
```bitbake
BBPATH .= ":${LAYERDIR}"

BBFILES += "${LAYERDIR}/recipes-*/*/*.bb ${LAYERDIR}/recipes-*/*/*.bbappend"

BBFILE_COLLECTIONS += "automotive-message-broker"
BBFILE_PATTERN_automotive-message-broker := "^${LAYERDIR}/"
BBFILE_PRIORITY_automotive-message-broker = "9"
```
